#include <stm32f4xx.h>
#include "Hardware/CPU/CPU.h"
#include "Interface/Interface.h"
#include "Utils/Debug.h"


#ifdef __cplusplus
extern "C" {
#endif

    //------------------------------------------------------------------------------------------------------------------------------------------------
    void SysTick_Handler()
    {
        HAL_IncTick();
        HAL_SYSTICK_IRQHandler();
    }

    //------------------------------------------------------------------------------------------------------------------------------------------------
    void SPI1_IRQHandler()
    {
        HAL_SPI_IRQHandler(CPU::SPI1_::Handle());
    }

    //------------------------------------------------------------------------------------------------------------------------------------------------
    void OTG_FS_IRQHandler()
    {
        HAL_HCD_IRQHandler(CPU::HCD::Handle());
    }
    
    //------------------------------------------------------------------------------------------------------------------------------------------------
    void MemManage_Handler()
    {
        while (1)
        {
        }
    }

    //------------------------------------------------------------------------------------------------------------------------------------------------
    void UsageFault_Handler()
    {
        while (1)
        {
        }
    }

    //------------------------------------------------------------------------------------------------------------------------------------------------
    void HardFault_Handler()
    {
        while (1)
        {
        }
    }

    //------------------------------------------------------------------------------------------------------------------------------------------------
    void BusFault_Handler()
    {
        while (1)
        {
        }
    }

    //------------------------------------------------------------------------------------------------------------------------------------------------
    void PendSV_Handler()
    {
    }

    //------------------------------------------------------------------------------------------------------------------------------------------------
    void NMI_Handler()
    {
    }

    //------------------------------------------------------------------------------------------------------------------------------------------------
    void SVC_Handler()
    {
    }

    //------------------------------------------------------------------------------------------------------------------------------------------------
    void DebugMon_Handler()
    {
    }

#ifdef __cplusplus
}
#endif
