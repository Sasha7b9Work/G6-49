/*
    Name - GOST type B
    Size - 20
    Width - bold
    Style - normal
    Cell width - 16
    Cell height - 20
    Offset x - -2
    Offset y - -7
*/
const unsigned char fontGOSTB20[5595] =
{
/* 0x00 */   0x00, 0x00,
/* 0x01 */   0x00, 0x00,
/* 0x02 */   0x00, 0x00,
/* 0x03 */   0x00, 0x00,
/* 0x04 */   0x00, 0x00,
/* 0x05 */   0x00, 0x00,
/* 0x06 */   0x00, 0x00,
/* 0x07 */   0x00, 0x00,
/* 0x08 */   0x00, 0x00,
/* 0x09 */   0x00, 0x00,
/* 0x0A */   0x00, 0x00,
/* 0x0B */   0x00, 0x00,
/* 0x0C */   0x00, 0x00,
/* 0x0D */   0x00, 0x00,
/* 0x0E */   0x00, 0x00,
/* 0x0F */   0x00, 0x00,
/* 0x10 */   0x00, 0x00,
/* 0x11 */   0x00, 0x00,
/* 0x12 */   0x00, 0x00,
/* 0x13 */   0x00, 0x00,
/* 0x14 */   0x00, 0x00,
/* 0x15 */   0x00, 0x00,
/* 0x16 */   0x00, 0x00,
/* 0x17 */   0x00, 0x00,
/* 0x18 */   0x00, 0x00,
/* 0x19 */   0x00, 0x00,
/* 0x1A */   0x00, 0x00,
/* 0x1B */   0x00, 0x00,
/* 0x1C */   0x00, 0x00,
/* 0x1D */   0x00, 0x00,
/* 0x1E */   0x00, 0x00,
/* 0x1F */   0x00, 0x00,
/* 0x20 */   0x00, 0x02,
/* 0x21 */   0x05, 0x02,
/* 0x22 */   0x1A, 0x02,
/* 0x23 */   0x22, 0x02,
/* 0x24 */   0x49, 0x02,
/* 0x25 */   0x74, 0x02,
/* 0x26 */   0x9B, 0x02,
/* 0x27 */   0xC2, 0x02,
/* 0x28 */   0xCA, 0x02,
/* 0x29 */   0xE1, 0x02,
/* 0x2A */   0xF8, 0x02,
/* 0x2B */   0x09, 0x03,
/* 0x2C */   0x1E, 0x03,
/* 0x2D */   0x26, 0x03,
/* 0x2E */   0x2B, 0x03,
/* 0x2F */   0x30, 0x03,
/* 0x30 */   0x5B, 0x03,
/* 0x31 */   0x82, 0x03,
/* 0x32 */   0x97, 0x03,
/* 0x33 */   0xBE, 0x03,
/* 0x34 */   0xE5, 0x03,
/* 0x35 */   0x0C, 0x04,
/* 0x36 */   0x33, 0x04,
/* 0x37 */   0x5A, 0x04,
/* 0x38 */   0x81, 0x04,
/* 0x39 */   0xA8, 0x04,
/* 0x3A */   0xCF, 0x04,
/* 0x3B */   0xDB, 0x04,
/* 0x3C */   0xE9, 0x04,
/* 0x3D */   0xFE, 0x04,
/* 0x3E */   0x0D, 0x05,
/* 0x3F */   0x22, 0x05,
/* 0x40 */   0x49, 0x05,
/* 0x41 */   0x70, 0x05,
/* 0x42 */   0x97, 0x05,
/* 0x43 */   0xBE, 0x05,
/* 0x44 */   0xE5, 0x05,
/* 0x45 */   0x0C, 0x06,
/* 0x46 */   0x33, 0x06,
/* 0x47 */   0x5A, 0x06,
/* 0x48 */   0x81, 0x06,
/* 0x49 */   0xA8, 0x06,
/* 0x4A */   0xBD, 0x06,
/* 0x4B */   0xD2, 0x06,
/* 0x4C */   0xF9, 0x06,
/* 0x4D */   0x20, 0x07,
/* 0x4E */   0x47, 0x07,
/* 0x4F */   0x6E, 0x07,
/* 0x50 */   0x95, 0x07,
/* 0x51 */   0xBC, 0x07,
/* 0x52 */   0xE3, 0x07,
/* 0x53 */   0x0A, 0x08,
/* 0x54 */   0x31, 0x08,
/* 0x55 */   0x58, 0x08,
/* 0x56 */   0x7F, 0x08,
/* 0x57 */   0xA6, 0x08,
/* 0x58 */   0xCD, 0x08,
/* 0x59 */   0xF4, 0x08,
/* 0x5A */   0x1B, 0x09,
/* 0x5B */   0x42, 0x09,
/* 0x5C */   0x59, 0x09,
/* 0x5D */   0x84, 0x09,
/* 0x5E */   0x9B, 0x09,
/* 0x5F */   0xA0, 0x09,
/* 0x60 */   0xA5, 0x09,
/* 0x61 */   0xCC, 0x09,
/* 0x62 */   0xE9, 0x09,
/* 0x63 */   0x10, 0x0A,
/* 0x64 */   0x20, 0x0A,
/* 0x65 */   0x47, 0x0A,
/* 0x66 */   0x64, 0x0A,
/* 0x67 */   0x79, 0x0A,
/* 0x68 */   0x9A, 0x0A,
/* 0x69 */   0xC1, 0x0A,
/* 0x6A */   0xD6, 0x0A,
/* 0x6B */   0xED, 0x0A,
/* 0x6C */   0x14, 0x0B,
/* 0x6D */   0x29, 0x0B,
/* 0x6E */   0x46, 0x0B,
/* 0x6F */   0x63, 0x0B,
/* 0x70 */   0x80, 0x0B,
/* 0x71 */   0xA1, 0x0B,
/* 0x72 */   0xC2, 0x0B,
/* 0x73 */   0xD2, 0x0B,
/* 0x74 */   0xEF, 0x0B,
/* 0x75 */   0x04, 0x0C,
/* 0x76 */   0x21, 0x0C,
/* 0x77 */   0x3E, 0x0C,
/* 0x78 */   0x5B, 0x0C,
/* 0x79 */   0x78, 0x0C,
/* 0x7A */   0x99, 0x0C,
/* 0x7B */   0xB6, 0x0C,
/* 0x7C */   0xCD, 0x0C,
/* 0x7D */   0xE2, 0x0C,
/* 0x7E */   0xF9, 0x0C,
/* 0x7F */   0x02, 0x0D,
/* 0x80 */   0x00, 0x00,
/* 0x81 */   0x00, 0x00,
/* 0x82 */   0x00, 0x00,
/* 0x83 */   0x00, 0x00,
/* 0x84 */   0x00, 0x00,
/* 0x85 */   0x00, 0x00,
/* 0x86 */   0x00, 0x00,
/* 0x87 */   0x00, 0x00,
/* 0x88 */   0x00, 0x00,
/* 0x89 */   0x00, 0x00,
/* 0x8A */   0x00, 0x00,
/* 0x8B */   0x00, 0x00,
/* 0x8C */   0x00, 0x00,
/* 0x8D */   0x00, 0x00,
/* 0x8E */   0x00, 0x00,
/* 0x8F */   0x00, 0x00,
/* 0x90 */   0x00, 0x00,
/* 0x91 */   0x00, 0x00,
/* 0x92 */   0x00, 0x00,
/* 0x93 */   0x00, 0x00,
/* 0x94 */   0x00, 0x00,
/* 0x95 */   0x00, 0x00,
/* 0x96 */   0x00, 0x00,
/* 0x97 */   0x00, 0x00,
/* 0x98 */   0x00, 0x00,
/* 0x99 */   0x00, 0x00,
/* 0x9A */   0x00, 0x00,
/* 0x9B */   0x00, 0x00,
/* 0x9C */   0x00, 0x00,
/* 0x9D */   0x00, 0x00,
/* 0x9E */   0x00, 0x00,
/* 0x9F */   0x00, 0x00,
/* 0xA0 */   0x00, 0x00,
/* 0xA1 */   0x00, 0x00,
/* 0xA2 */   0x00, 0x00,
/* 0xA3 */   0x00, 0x00,
/* 0xA4 */   0x00, 0x00,
/* 0xA5 */   0x00, 0x00,
/* 0xA6 */   0x00, 0x00,
/* 0xA7 */   0x00, 0x00,
/* 0xA8 */   0x00, 0x00,
/* 0xA9 */   0x00, 0x00,
/* 0xAA */   0x00, 0x00,
/* 0xAB */   0x00, 0x00,
/* 0xAC */   0x00, 0x00,
/* 0xAD */   0x00, 0x00,
/* 0xAE */   0x00, 0x00,
/* 0xAF */   0x00, 0x00,
/* 0xB0 */   0x00, 0x00,
/* 0xB1 */   0x00, 0x00,
/* 0xB2 */   0x00, 0x00,
/* 0xB3 */   0x00, 0x00,
/* 0xB4 */   0x00, 0x00,
/* 0xB5 */   0x00, 0x00,
/* 0xB6 */   0x00, 0x00,
/* 0xB7 */   0x00, 0x00,
/* 0xB8 */   0x00, 0x00,
/* 0xB9 */   0x00, 0x00,
/* 0xBA */   0x00, 0x00,
/* 0xBB */   0x00, 0x00,
/* 0xBC */   0x00, 0x00,
/* 0xBD */   0x00, 0x00,
/* 0xBE */   0x00, 0x00,
/* 0xBF */   0x00, 0x00,
/* 0xC0 */   0x18, 0x0D,
/* 0xC1 */   0x3F, 0x0D,
/* 0xC2 */   0x66, 0x0D,
/* 0xC3 */   0x8D, 0x0D,
/* 0xC4 */   0xB4, 0x0D,
/* 0xC5 */   0xDF, 0x0D,
/* 0xC6 */   0x06, 0x0E,
/* 0xC7 */   0x2D, 0x0E,
/* 0xC8 */   0x54, 0x0E,
/* 0xC9 */   0x7B, 0x0E,
/* 0xCA */   0xA2, 0x0E,
/* 0xCB */   0xC9, 0x0E,
/* 0xCC */   0xF0, 0x0E,
/* 0xCD */   0x17, 0x0F,
/* 0xCE */   0x3E, 0x0F,
/* 0xCF */   0x65, 0x0F,
/* 0xD0 */   0x8C, 0x0F,
/* 0xD1 */   0xB3, 0x0F,
/* 0xD2 */   0xDA, 0x0F,
/* 0xD3 */   0x01, 0x10,
/* 0xD4 */   0x28, 0x10,
/* 0xD5 */   0x4F, 0x10,
/* 0xD6 */   0x76, 0x10,
/* 0xD7 */   0xA1, 0x10,
/* 0xD8 */   0xC8, 0x10,
/* 0xD9 */   0xEF, 0x10,
/* 0xDA */   0x1A, 0x11,
/* 0xDB */   0x41, 0x11,
/* 0xDC */   0x68, 0x11,
/* 0xDD */   0x8F, 0x11,
/* 0xDE */   0xB6, 0x11,
/* 0xDF */   0xDD, 0x11,
/* 0xE0 */   0x04, 0x12,
/* 0xE1 */   0x21, 0x12,
/* 0xE2 */   0x48, 0x12,
/* 0xE3 */   0x6F, 0x12,
/* 0xE4 */   0x8C, 0x12,
/* 0xE5 */   0xB3, 0x12,
/* 0xE6 */   0xD0, 0x12,
/* 0xE7 */   0xED, 0x12,
/* 0xE8 */   0x0A, 0x13,
/* 0xE9 */   0x27, 0x13,
/* 0xEA */   0x4E, 0x13,
/* 0xEB */   0x6B, 0x13,
/* 0xEC */   0x88, 0x13,
/* 0xED */   0xA5, 0x13,
/* 0xEE */   0xC2, 0x13,
/* 0xEF */   0xDF, 0x13,
/* 0xF0 */   0xFC, 0x13,
/* 0xF1 */   0x1D, 0x14,
/* 0xF2 */   0x2D, 0x14,
/* 0xF3 */   0x4A, 0x14,
/* 0xF4 */   0x6B, 0x14,
/* 0xF5 */   0x94, 0x14,
/* 0xF6 */   0xB1, 0x14,
/* 0xF7 */   0xD2, 0x14,
/* 0xF8 */   0xEF, 0x14,
/* 0xF9 */   0x0C, 0x15,
/* 0xFA */   0x2D, 0x15,
/* 0xFB */   0x4A, 0x15,
/* 0xFC */   0x67, 0x15,
/* 0xFD */   0x84, 0x15,
/* 0xFE */   0xA1, 0x15,
/* 0xFF */   0xBE, 0x15,

/* Symbol 0x20, offset 512 */
    16, 1, 0,
    0x00, 0x00, 

/* Symbol 0x21, offset 517 */
    3, 18, 0,
    0xE0, 0xE0, 0xE0, 0xE0, 0xE0, 0xE0, 0xE0, 0xE0, 0xE0, 0xE0, 0xE0, 0xE0, 0xE0, 0xE0, 0x00, 0x00, 0xE0, 0xE0, 

/* Symbol 0x22, offset 538 */
    6, 5, 0,
    0xFC, 0xDC, 0xDC, 0xDC, 0xD8, 

/* Symbol 0x23, offset 546 */
    15, 18, 0,
    0x07, 0x1C, 0x07, 0x1C, 0x07, 0x38, 0x06, 0x38, 0x3F, 0xFE, 0x3F, 0xFE,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 0xC0, 

/* Symbol 0x24, offset 585 */
    12, 20, 0,
    0x3F, 0xC0, 0x7F, 0xF0, 0xE6, 0x60, 0xE6, 0x00, 0xE6, 0x00, 0x76, 0x00,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 0x00, 

/* Symbol 0x25, offset 628 */
    16, 18, 0,
    0x7F, 0x00, 0xF7, 0x80, 0xE3, 0x81, 0xE3, 0x83, 0xE3, 0x83, 0xE3, 0x87,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 0x00, 

/* Symbol 0x26, offset 667 */
    14, 18, 0,
    0x1F, 0x80, 0x1F, 0xC0, 0x38, 0xC0, 0x38, 0xC0, 0x3D, 0xC0, 0x1F, 0x80,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 0x9C, 

/* Symbol 0x27, offset 706 */
    3, 5, 0,
    0xE0, 0xE0, 0xC0, 0xC0, 0xC0, 

/* Symbol 0x28, offset 714 */
    6, 20, 0,
    0x3C, 0x38, 0x70, 0x70, 0x70, 0xE0, 0xE0, 0xE0, 0xE0, 0xE0, 0xE0, 0xE0, 0xE0, 0xE0, 0x60, 0x70, 0x70, 0x70, 0x38, 0x38, 

/* Symbol 0x29, offset 737 */
    5, 20, 0,
    0xE0, 0x70, 0x70, 0x70, 0x38, 0x38, 0x38, 0x38, 0x38, 0x38, 0x38, 0x38, 0x38, 0x38, 0x38, 0x30, 0x70, 0x70, 0xE0, 0xE0, 

/* Symbol 0x2A, offset 760 */
    9, 7, 0,
    0x77, 0x00, 0x3E, 0x00, 0xFF, 0x80, 0xFF, 0x80, 0x3E, 0x00, 0x3F, 0x00, 0x77, 0x00, 

/* Symbol 0x2B, offset 777 */
    10, 16, 7,
    0x0C, 0x00, 0x0C, 0x00, 0x0C, 0x00, 0x0C, 0x00, 0xFF, 0xC0, 0x0C, 0x00, 0x0C, 0x00, 0x0C, 0x00, 0x0C, 0x00, 

/* Symbol 0x2C, offset 798 */
    3, 20, 15,
    0xE0, 0xE0, 0xE0, 0xC0, 0xC0, 

/* Symbol 0x2D, offset 806 */
    10, 12, 11,
    0xFF, 0xC0, 

/* Symbol 0x2E, offset 811 */
    3, 18, 16,
    0xE0, 0xE0, 

/* Symbol 0x2F, offset 816 */
    11, 20, 0,
    0x00, 0xE0, 0x01, 0xC0, 0x01, 0xC0, 0x01, 0xC0, 0x03, 0x80, 0x03, 0x80,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 0x00, 

/* Symbol 0x30, offset 859 */
    10, 18, 0,
    0x7F, 0x80, 0xF3, 0x80, 0xE1, 0xC0, 0xE1, 0xC0, 0xE1, 0xC0, 0xE1, 0xC0,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 0x00, 

/* Symbol 0x31, offset 898 */
    6, 18, 0,
    0x1C, 0x3C, 0x7C, 0xFC, 0xEC, 0x0C, 0x0C, 0x0C, 0x0C, 0x0C, 0x0C, 0x0C, 0x0C, 0x0C, 0x0C, 0x0C, 0x0C, 0x0C, 

/* Symbol 0x32, offset 919 */
    10, 18, 0,
    0x7F, 0x00, 0xF7, 0x80, 0xE3, 0xC0, 0x01, 0xC0, 0x01, 0xC0, 0x01, 0xC0,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 0xC0, 

/* Symbol 0x33, offset 958 */
    10, 18, 0,
    0xFF, 0x00, 0x07, 0x80, 0x01, 0xC0, 0x01, 0xC0, 0x01, 0xC0, 0x01, 0xC0,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 0x00, 

/* Symbol 0x34, offset 997 */
    12, 18, 0,
    0x1C, 0x00, 0x1C, 0x00, 0x1C, 0x00, 0x1C, 0x00, 0x38, 0x00, 0x38, 0x00,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 0x80, 

/* Symbol 0x35, offset 1036 */
    10, 18, 0,
    0xFF, 0xC0, 0xE0, 0x00, 0xE0, 0x00, 0xE0, 0x00, 0xE0, 0x00, 0xE0, 0x00,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 0x00, 

/* Symbol 0x36, offset 1075 */
    10, 18, 0,
    0x0F, 0x00, 0x1E, 0x00, 0x3C, 0x00, 0x78, 0x00, 0x70, 0x00, 0x70, 0x00,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 0x00, 

/* Symbol 0x37, offset 1114 */
    10, 18, 0,
    0xFF, 0xC0, 0xE1, 0xC0, 0xE1, 0xC0, 0x03, 0x80, 0x03, 0x80, 0x03, 0x80,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 0x00, 

/* Symbol 0x38, offset 1153 */
    12, 18, 0,
    0x3F, 0x80, 0x3F, 0xC0, 0x70, 0xE0, 0x70, 0xE0, 0x70, 0xE0, 0x70, 0xE0,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 0x80, 

/* Symbol 0x39, offset 1192 */
    10, 18, 0,
    0x7F, 0x80, 0xF3, 0xC0, 0xE1, 0xC0, 0xE1, 0xC0, 0xE1, 0xC0, 0xE1, 0xC0,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 0x00, 

/* Symbol 0x3A, offset 1231 */
    3, 18, 9,
    0xE0, 0xC0, 0x00, 0x00, 0x00, 0x00, 0x00, 0xE0, 0xE0, 

/* Symbol 0x3B, offset 1243 */
    3, 20, 9,
    0xE0, 0xC0, 0x00, 0x00, 0x00, 0x00, 0x00, 0xE0, 0xE0, 0xC0, 0xC0, 

/* Symbol 0x3C, offset 1257 */
    10, 16, 7,
    0x01, 0xC0, 0x07, 0xC0, 0x1F, 0x00, 0x7C, 0x00, 0xF0, 0x00, 0x7C, 0x00, 0x1F, 0x00, 0x07, 0xC0, 0x01, 0xC0, 

/* Symbol 0x3D, offset 1278 */
    10, 14, 8,
    0xFF, 0xC0, 0xFF, 0xC0, 0x00, 0x00, 0x00, 0x00, 0xFF, 0x80, 0xFF, 0xC0, 

/* Symbol 0x3E, offset 1293 */
    10, 16, 7,
    0xE0, 0x00, 0xF8, 0x00, 0x3E, 0x00, 0x0F, 0x80, 0x03, 0xC0, 0x0F, 0x80, 0x3E, 0x00, 0xF8, 0x00, 0xE0, 0x00, 

/* Symbol 0x3F, offset 1314 */
    10, 18, 0,
    0x7F, 0x00, 0xFF, 0x80, 0xE1, 0xC0, 0x01, 0xC0, 0x01, 0xC0, 0x03, 0xC0,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 0x00, 

/* Symbol 0x40, offset 1353 */
    16, 18, 0,
    0x07, 0xFC, 0x1F, 0xBF, 0x3C, 0x07, 0x78, 0x03, 0x71, 0xFD, 0xE3, 0xFC,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 0xF8, 

/* Symbol 0x41, offset 1392 */
    14, 18, 0,
    0x07, 0x00, 0x07, 0x80, 0x07, 0x80, 0x0F, 0x80, 0x0F, 0xC0, 0x0F, 0xC0,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 0x1C, 

/* Symbol 0x42, offset 1431 */
    12, 18, 0,
    0xFF, 0xC0, 0xE1, 0xE0, 0xE0, 0xE0, 0xE0, 0xE0, 0xE0, 0xE0, 0xE0, 0xE0,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 0xC0, 

/* Symbol 0x43, offset 1470 */
    10, 18, 0,
    0x7F, 0xC0, 0xF0, 0x00, 0xE0, 0x00, 0xE0, 0x00, 0xE0, 0x00, 0xE0, 0x00,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 0xC0, 

/* Symbol 0x44, offset 1509 */
    12, 18, 0,
    0xFF, 0xE0, 0xE0, 0xE0, 0xE0, 0x70, 0xE0, 0x70, 0xE0, 0x70, 0xE0, 0x70,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 0xC0, 

/* Symbol 0x45, offset 1548 */
    10, 18, 0,
    0xFF, 0xC0, 0xE0, 0x00, 0xE0, 0x00, 0xE0, 0x00, 0xE0, 0x00, 0xE0, 0x00,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 0xC0, 

/* Symbol 0x46, offset 1587 */
    10, 18, 0,
    0xFF, 0xC0, 0xE0, 0x00, 0xE0, 0x00, 0xE0, 0x00, 0xE0, 0x00, 0xE0, 0x00,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 0x00, 

/* Symbol 0x47, offset 1626 */
    12, 18, 0,
    0x7F, 0xF0, 0xF0, 0x00, 0xE0, 0x00, 0xE0, 0x00, 0xE0, 0x00, 0xE0, 0x00,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 0xF0, 

/* Symbol 0x48, offset 1665 */
    12, 18, 0,
    0xE0, 0x70, 0xE0, 0x70, 0xE0, 0x70, 0xE0, 0x70, 0xE0, 0x70, 0xE0, 0x70,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 0x70, 

/* Symbol 0x49, offset 1704 */
    3, 18, 0,
    0xE0, 0xE0, 0xE0, 0xE0, 0xE0, 0xE0, 0xE0, 0xE0, 0xE0, 0xE0, 0xE0, 0xE0, 0xE0, 0xE0, 0xE0, 0xE0, 0xE0, 0xE0, 

/* Symbol 0x4A, offset 1725 */
    8, 18, 0,
    0x07, 0x07, 0x07, 0x07, 0x07, 0x07, 0x07, 0x07, 0x07, 0x07, 0x07, 0x07, 0x07, 0x07, 0x07, 0x07, 0xFF, 0xFC, 

/* Symbol 0x4B, offset 1746 */
    12, 18, 0,
    0xE0, 0x70, 0xE0, 0xE0, 0xE1, 0xC0, 0xE3, 0x80, 0xE7, 0x00, 0xEE, 0x00,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 0x70, 

/* Symbol 0x4C, offset 1785 */
    10, 18, 0,
    0xE0, 0x00, 0xE0, 0x00, 0xE0, 0x00, 0xE0, 0x00, 0xE0, 0x00, 0xE0, 0x00,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 0xC0, 

/* Symbol 0x4D, offset 1824 */
    14, 18, 0,
    0xE0, 0x1C, 0xE0, 0x3C, 0xF0, 0x3C, 0xF8, 0x7C, 0xF8, 0xFC, 0xFC, 0xFC,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 0x1C, 

/* Symbol 0x4E, offset 1863 */
    12, 18, 0,
    0xE0, 0x70, 0xE0, 0x70, 0xF0, 0x70, 0xF0, 0x70, 0xF8, 0x70, 0xFC, 0x70,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 0x70, 

/* Symbol 0x4F, offset 1902 */
    12, 18, 0,
    0x7F, 0xE0, 0xF0, 0xE0, 0xE0, 0x70, 0xE0, 0x70, 0xE0, 0x70, 0xE0, 0x70,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 0xC0, 

/* Symbol 0x50, offset 1941 */
    12, 18, 0,
    0xFF, 0xE0, 0xE0, 0xE0, 0xE0, 0x70, 0xE0, 0x70, 0xE0, 0x70, 0xE0, 0x70,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 0x00, 

/* Symbol 0x51, offset 1980 */
    14, 18, 0,
    0x7F, 0xE0, 0xF0, 0xE0, 0xE0, 0x70, 0xE0, 0x70, 0xE0, 0x70, 0xE0, 0x70,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 0xDC, 

/* Symbol 0x52, offset 2019 */
    12, 18, 0,
    0xFF, 0xE0, 0xE0, 0xE0, 0xE0, 0x70, 0xE0, 0x70, 0xE0, 0x70, 0xE0, 0x70,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 0x70, 

/* Symbol 0x53, offset 2058 */
    12, 18, 0,
    0x3F, 0xC0, 0x79, 0xF0, 0xE0, 0x60, 0xE0, 0x00, 0xE0, 0x00, 0xF0, 0x00,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 0x80, 

/* Symbol 0x54, offset 2097 */
    12, 18, 0,
    0xFF, 0xF0, 0x0E, 0x00, 0x0E, 0x00, 0x0E, 0x00, 0x0E, 0x00, 0x0E, 0x00,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 0x00, 

/* Symbol 0x55, offset 2136 */
    12, 18, 0,
    0xE0, 0x70, 0xE0, 0x70, 0xE0, 0x70, 0xE0, 0x70, 0xE0, 0x70, 0xE0, 0x70,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 0xC0, 

/* Symbol 0x56, offset 2175 */
    14, 18, 0,
    0xE0, 0x1C, 0xE0, 0x18, 0xE0, 0x38, 0x70, 0x38, 0x70, 0x30, 0x70, 0x70,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 0x00, 

/* Symbol 0x57, offset 2214 */
    16, 18, 0,
    0xE0, 0x01, 0xE0, 0x03, 0xE0, 0x03, 0xE0, 0x03, 0x70, 0x03, 0x70, 0x07,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 0x1C, 

/* Symbol 0x58, offset 2253 */
    14, 18, 0,
    0xE0, 0x1C, 0xF0, 0x38, 0x70, 0x78, 0x38, 0x70, 0x3C, 0xE0, 0x1D, 0xE0,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 0x1C, 

/* Symbol 0x59, offset 2292 */
    14, 18, 0,
    0xE0, 0x1C, 0xF0, 0x38, 0x70, 0x78, 0x38, 0x70, 0x1C, 0xE0, 0x1D, 0xE0,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 0x00, 

/* Symbol 0x5A, offset 2331 */
    14, 18, 0,
    0xFF, 0xFC, 0x00, 0x38, 0x00, 0x78, 0x00, 0x70, 0x00, 0xE0, 0x01, 0xE0,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 0xFC, 

/* Symbol 0x5B, offset 2370 */
    5, 20, 0,
    0xE0, 0xE0, 0xE0, 0xE0, 0xE0, 0xE0, 0xE0, 0xE0, 0xE0, 0xE0, 0xE0, 0xE0, 0xE0, 0xE0, 0xE0, 0xE0, 0xE0, 0xE0, 0xF8, 0xF0, 

/* Symbol 0x5C, offset 2393 */
    10, 20, 0,
    0xE0, 0x00, 0xE0, 0x00, 0x70, 0x00, 0x70, 0x00, 0x38, 0x00, 0x38, 0x00,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 0xC0, 

/* Symbol 0x5D, offset 2436 */
    4, 20, 0,
    0x70, 0x70, 0x70, 0x70, 0x70, 0x70, 0x70, 0x70, 0x70, 0x70, 0x70, 0x70, 0x70, 0x70, 0x70, 0x70, 0x70, 0x70, 0xF0, 0xF0, 

/* Symbol 0x5E, offset 2459 */
    16, 1, 0,
    0x00, 0x00, 

/* Symbol 0x5F, offset 2464 */
    10, 20, 19,
    0xFF, 0xC0, 

/* Symbol 0x60, offset 2469 */
    12, 18, 0,
    0x80, 0x30, 0x80, 0x30, 0x80, 0x30, 0x80, 0x30, 0x80, 0x30, 0x80, 0x30,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 0xF0, 

/* Symbol 0x61, offset 2508 */
    12, 18, 5,
    0x3F, 0xC0, 0x7F, 0xC0, 0xE1, 0xC0, 0xE1, 0xC0, 0xE1, 0xC0, 0xE1, 0xC0, 0xE1, 0xC0, 0xE1, 0xC0, 0xE1, 0xC0, 0xE1, 0xC0, 0xE1, 0xC0, 0x7F, 0xF0, 0x3F, 0x70, 

/* Symbol 0x62, offset 2537 */
    10, 18, 0,
    0xE0, 0x00, 0xE0, 0x00, 0xE0, 0x00, 0xE0, 0x00, 0xE0, 0x00, 0xFF, 0x00,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 0x00, 

/* Symbol 0x63, offset 2576 */
    8, 18, 5,
    0x3F, 0x7F, 0xE0, 0xE0, 0xE0, 0xE0, 0xE0, 0xE0, 0xE0, 0xE0, 0xE0, 0x7F, 0x3F, 

/* Symbol 0x64, offset 2592 */
    10, 18, 0,
    0x01, 0xC0, 0x01, 0xC0, 0x01, 0xC0, 0x01, 0xC0, 0x01, 0xC0, 0x3F, 0xC0,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 0xC0, 

/* Symbol 0x65, offset 2631 */
    10, 18, 5,
    0x3F, 0x00, 0x7F, 0x80, 0xE1, 0xC0, 0xE1, 0xC0, 0xE1, 0xC0, 0xE1, 0xC0, 0xFF, 0xC0, 0xE0, 0x00, 0xE0, 0x00, 0xE0, 0x00, 0xE0, 0x00, 0x7F, 0xC0, 0x3F, 0xC0, 

/* Symbol 0x66, offset 2660 */
    7, 18, 0,
    0x3E, 0x78, 0x70, 0x70, 0x70, 0xFE, 0xFE, 0x70, 0x70, 0x70, 0x70, 0x70, 0x70, 0x70, 0x70, 0x70, 0x70, 0x70, 

/* Symbol 0x67, offset 2681 */
    10, 20, 5,
    0x3F, 0xC0, 0x7F, 0xC0, 0xE1, 0xC0, 0xE1, 0xC0, 0xE1, 0xC0, 0xE1, 0xC0, 0xE1, 0xC0, 0xE1, 0xC0, 0xE1, 0xC0, 0xE1, 0xC0, 0xE1, 0xC0, 0x7F, 0xC0, 0x3F, 0xC0, 0x01, 0xC0, 0x01, 0xC0, 

/* Symbol 0x68, offset 2714 */
    10, 18, 0,
    0xE0, 0x00, 0xE0, 0x00, 0xE0, 0x00, 0xE0, 0x00, 0xE0, 0x00, 0xFF, 0x00,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 0xC0, 

/* Symbol 0x69, offset 2753 */
    3, 18, 0,
    0xE0, 0x00, 0x00, 0x00, 0x00, 0xE0, 0xE0, 0xE0, 0xE0, 0xE0, 0xE0, 0xE0, 0xE0, 0xE0, 0xE0, 0xE0, 0xE0, 0xE0, 

/* Symbol 0x6A, offset 2774 */
    3, 20, 0,
    0xE0, 0x00, 0x00, 0x00, 0x00, 0xE0, 0xE0, 0xE0, 0xE0, 0xE0, 0xE0, 0xE0, 0xE0, 0xE0, 0xE0, 0xE0, 0xE0, 0xE0, 0xE0, 0xE0, 

/* Symbol 0x6B, offset 2797 */
    10, 18, 0,
    0xE0, 0x00, 0xE0, 0x00, 0xE0, 0x00, 0xE0, 0x00, 0xE0, 0x00, 0xE1, 0xC0,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 0xC0, 

/* Symbol 0x6C, offset 2836 */
    5, 18, 0,
    0xE0, 0xE0, 0xE0, 0xE0, 0xE0, 0xE0, 0xE0, 0xE0, 0xE0, 0xE0, 0xE0, 0xE0, 0xE0, 0xE0, 0xE0, 0xE0, 0xF0, 0x78, 

/* Symbol 0x6D, offset 2857 */
    14, 18, 5,
    0xFF, 0xF0, 0xFF, 0xF8, 0xE7, 0x3C, 0xE7, 0x1C, 0xE7, 0x1C, 0xE7, 0x1C, 0xE7, 0x1C, 0xE7, 0x1C, 0xE7, 0x1C, 0xE7, 0x1C, 0xE7, 0x1C, 0xE7, 0x1C, 0xE7, 0x1C, 

/* Symbol 0x6E, offset 2886 */
    10, 18, 5,
    0xFF, 0x00, 0xFF, 0x80, 0xE1, 0xC0, 0xE1, 0xC0, 0xE1, 0xC0, 0xE1, 0xC0, 0xE1, 0xC0, 0xE1, 0xC0, 0xE1, 0xC0, 0xE1, 0xC0, 0xE1, 0xC0, 0xE1, 0xC0, 0xE1, 0xC0, 

/* Symbol 0x6F, offset 2915 */
    10, 18, 5,
    0x3F, 0x00, 0x7F, 0x80, 0xE1, 0xC0, 0xE1, 0xC0, 0xE1, 0xC0, 0xE1, 0xC0, 0xE1, 0xC0, 0xE1, 0xC0, 0xE1, 0xC0, 0xE1, 0xC0, 0xE1, 0xC0, 0x7F, 0x80, 0x3F, 0x00, 

/* Symbol 0x70, offset 2944 */
    10, 20, 5,
    0xFF, 0x00, 0xFF, 0x80, 0xE1, 0xC0, 0xE1, 0xC0, 0xE1, 0xC0, 0xE1, 0xC0, 0xE1, 0xC0, 0xE1, 0xC0, 0xE1, 0xC0, 0xE1, 0xC0, 0xE1, 0xC0, 0xFF, 0x80, 0xFF, 0x00, 0xE0, 0x00, 0xE0, 0x00, 

/* Symbol 0x71, offset 2977 */
    10, 20, 5,
    0x3F, 0xC0, 0x7F, 0xC0, 0xE1, 0xC0, 0xE1, 0xC0, 0xE1, 0xC0, 0xE1, 0xC0, 0xE1, 0xC0, 0xE1, 0xC0, 0xE1, 0xC0, 0xE1, 0xC0, 0xE1, 0xC0, 0x7F, 0xC0, 0x3F, 0xC0, 0x01, 0xC0, 0x01, 0xC0, 

/* Symbol 0x72, offset 3010 */
    8, 18, 5,
    0xFE, 0xFF, 0xE7, 0xE3, 0xE0, 0xE0, 0xE0, 0xE0, 0xE0, 0xE0, 0xE0, 0xE0, 0xE0, 

/* Symbol 0x73, offset 3026 */
    10, 18, 5,
    0x3F, 0x00, 0x7F, 0xC0, 0xE1, 0xC0, 0xE0, 0x00, 0xF0, 0x00, 0x7C, 0x00, 0x1E, 0x00, 0x0F, 0x80, 0x03, 0xC0, 0x01, 0xC0, 0xE1, 0xC0, 0xFF, 0x80, 0x3F, 0x00, 

/* Symbol 0x74, offset 3055 */
    8, 18, 0,
    0x38, 0x38, 0x38, 0x38, 0x38, 0xFF, 0xFF, 0x38, 0x38, 0x38, 0x38, 0x38, 0x38, 0x38, 0x38, 0x38, 0x38, 0x30, 

/* Symbol 0x75, offset 3076 */
    10, 18, 5,
    0xE1, 0xC0, 0xE1, 0xC0, 0xE1, 0xC0, 0xE1, 0xC0, 0xE1, 0xC0, 0xE1, 0xC0, 0xE1, 0xC0, 0xE1, 0xC0, 0xE1, 0xC0, 0xE1, 0xC0, 0xE1, 0xC0, 0x7F, 0xC0, 0x3F, 0xC0, 

/* Symbol 0x76, offset 3105 */
    10, 18, 5,
    0xE1, 0xC0, 0xE1, 0xC0, 0xE1, 0xC0, 0x73, 0x80, 0x73, 0x80, 0x73, 0x80, 0x3F, 0x00, 0x3F, 0x00, 0x3F, 0x00, 0x1E, 0x00, 0x1E, 0x00, 0x1E, 0x00, 0x0C, 0x00, 

/* Symbol 0x77, offset 3134 */
    14, 18, 5,
    0xE0, 0x1C, 0xE0, 0x1C, 0xE0, 0x18, 0xE0, 0x38, 0x77, 0x38, 0x77, 0xB8, 0x77, 0xB0, 0x7F, 0xF0, 0x3F, 0xF0, 0x3D, 0xF0, 0x3D, 0xE0, 0x3C, 0xE0, 0x18, 0xE0, 

/* Symbol 0x78, offset 3163 */
    10, 18, 5,
    0xE1, 0xC0, 0xE1, 0xC0, 0x73, 0x80, 0x7F, 0x80, 0x3F, 0x00, 0x1E, 0x00, 0x1E, 0x00, 0x1E, 0x00, 0x3F, 0x00, 0x7F, 0x80, 0x73, 0x80, 0xE1, 0xC0, 0xE1, 0xC0, 

/* Symbol 0x79, offset 3192 */
    10, 20, 5,
    0xC1, 0xC0, 0xE1, 0xC0, 0xE1, 0x80, 0xE3, 0x80, 0x73, 0x80, 0x73, 0x80, 0x77, 0x00, 0x3F, 0x00, 0x3F, 0x00, 0x3E, 0x00, 0x1E, 0x00, 0x1E, 0x00, 0x1C, 0x00, 0x1C, 0x00, 0x1C, 0x00, 

/* Symbol 0x7A, offset 3225 */
    10, 18, 5,
    0xFF, 0xC0, 0xFF, 0xC0, 0x03, 0x80, 0x07, 0x80, 0x07, 0x00, 0x0E, 0x00, 0x1E, 0x00, 0x1C, 0x00, 0x38, 0x00, 0x78, 0x00, 0x70, 0x00, 0xFF, 0xC0, 0xFF, 0xC0, 

/* Symbol 0x7B, offset 3254 */
    7, 20, 0,
    0x38, 0x38, 0x38, 0x38, 0x38, 0x38, 0x38, 0x38, 0xF0, 0xF0, 0x38, 0x38, 0x38, 0x38, 0x38, 0x38, 0x38, 0x38, 0x3C, 0x1E, 

/* Symbol 0x7C, offset 3277 */
    7, 18, 0,
    0xEE, 0xEE, 0xEE, 0xEE, 0xEE, 0xEE, 0xEE, 0xEE, 0xEE, 0xEE, 0xEE, 0xEE, 0xEE, 0xEE, 0xEE, 0xEE, 0xEE, 0xE6, 

/* Symbol 0x7D, offset 3298 */
    6, 20, 0,
    0x38, 0x38, 0x38, 0x38, 0x38, 0x38, 0x38, 0x38, 0x3C, 0x3C, 0x38, 0x38, 0x38, 0x38, 0x38, 0x38, 0x38, 0x38, 0xF0, 0xE0, 

/* Symbol 0x7E, offset 3321 */
    12, 13, 10,
    0x7E, 0x00, 0xFF, 0xF0, 0x07, 0xE0, 

/* Symbol 0x7F, offset 3330 */
    6, 19, 0,
    0x8C, 0x8C, 0x8C, 0x8C, 0x8C, 0x8C, 0x8C, 0x8C, 0x8C, 0x8C, 0x8C, 0x8C, 0x8C, 0x8C, 0x8C, 0x8C, 0x8C, 0x8C, 0xFC, 

/* Symbol 0xC0, offset 3352 */
    14, 18, 0,
    0x07, 0x00, 0x07, 0x80, 0x07, 0x80, 0x0F, 0x80, 0x0F, 0xC0, 0x0F, 0xC0,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 0x1C, 

/* Symbol 0xC1, offset 3391 */
    12, 18, 0,
    0xFF, 0xC0, 0xE0, 0x00, 0xE0, 0x00, 0xE0, 0x00, 0xE0, 0x00, 0xE0, 0x00,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 0xC0, 

/* Symbol 0xC2, offset 3430 */
    12, 18, 0,
    0xFF, 0xC0, 0xE1, 0xE0, 0xE0, 0xE0, 0xE0, 0xE0, 0xE0, 0xE0, 0xE0, 0xE0,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 0xC0, 

/* Symbol 0xC3, offset 3469 */
    10, 18, 0,
    0xFF, 0xC0, 0xE0, 0x00, 0xE0, 0x00, 0xE0, 0x00, 0xE0, 0x00, 0xE0, 0x00,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 0x00, 

/* Symbol 0xC4, offset 3508 */
    14, 20, 0,
    0x0F, 0xF0, 0x1C, 0x70, 0x1C, 0x70, 0x1C, 0x70, 0x1C, 0x70, 0x1C, 0x70,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 0x1C, 

/* Symbol 0xC5, offset 3551 */
    10, 18, 0,
    0xFF, 0xC0, 0xE0, 0x00, 0xE0, 0x00, 0xE0, 0x00, 0xE0, 0x00, 0xE0, 0x00,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 0xC0, 

/* Symbol 0xC6, offset 3590 */
    16, 18, 0,
    0xE3, 0x87, 0xF3, 0x8E, 0x73, 0x9C, 0x3B, 0xBC, 0x3F, 0xB8, 0x1F, 0xF0,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 0x87, 

/* Symbol 0xC7, offset 3629 */
    10, 18, 0,
    0x7F, 0x80, 0xF3, 0xC0, 0xE1, 0xC0, 0x01, 0xC0, 0x01, 0xC0, 0x01, 0xC0,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 0x00, 

/* Symbol 0xC8, offset 3668 */
    12, 18, 0,
    0xE0, 0x70, 0xE0, 0xF0, 0xE0, 0xF0, 0xE1, 0xF0, 0xE1, 0xF0, 0xE3, 0xF0,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 0x70, 

/* Symbol 0xC9, offset 3707 */
    12, 18, 0,
    0xE0, 0x70, 0xE0, 0xF0, 0xE0, 0xF0, 0xE1, 0xF0, 0xE1, 0xF0, 0xE3, 0xF0,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 0x70, 

/* Symbol 0xCA, offset 3746 */
    12, 18, 0,
    0xE0, 0x70, 0xE0, 0xE0, 0xE1, 0xC0, 0xE3, 0x80, 0xE7, 0x00, 0xEE, 0x00,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 0x70, 

/* Symbol 0xCB, offset 3785 */
    12, 18, 0,
    0x0F, 0xF0, 0x0E, 0x70, 0x0E, 0x70, 0x0C, 0x70, 0x1C, 0x70, 0x1C, 0x70,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 0x70, 

/* Symbol 0xCC, offset 3824 */
    14, 18, 0,
    0xE0, 0x1C, 0xE0, 0x3C, 0xF0, 0x3C, 0xF8, 0x7C, 0xF8, 0xFC, 0xFC, 0xFC,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 0x1C, 

/* Symbol 0xCD, offset 3863 */
    12, 18, 0,
    0xE0, 0x70, 0xE0, 0x70, 0xE0, 0x70, 0xE0, 0x70, 0xE0, 0x70, 0xE0, 0x70,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 0x70, 

/* Symbol 0xCE, offset 3902 */
    12, 18, 0,
    0x7F, 0xE0, 0xF0, 0xE0, 0xE0, 0x70, 0xE0, 0x70, 0xE0, 0x70, 0xE0, 0x70,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 0xC0, 

/* Symbol 0xCF, offset 3941 */
    12, 18, 0,
    0xFF, 0xF0, 0xE0, 0x70, 0xE0, 0x70, 0xE0, 0x70, 0xE0, 0x70, 0xE0, 0x70,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 0x70, 

/* Symbol 0xD0, offset 3980 */
    12, 18, 0,
    0xFF, 0xE0, 0xE0, 0xE0, 0xE0, 0x70, 0xE0, 0x70, 0xE0, 0x70, 0xE0, 0x70,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 0x00, 

/* Symbol 0xD1, offset 4019 */
    10, 18, 0,
    0x7F, 0xC0, 0xF0, 0x00, 0xE0, 0x00, 0xE0, 0x00, 0xE0, 0x00, 0xE0, 0x00,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 0xC0, 

/* Symbol 0xD2, offset 4058 */
    12, 18, 0,
    0xFF, 0xF0, 0x0E, 0x00, 0x0E, 0x00, 0x0E, 0x00, 0x0E, 0x00, 0x0E, 0x00,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 0x00, 

/* Symbol 0xD3, offset 4097 */
    12, 18, 0,
    0xE0, 0x70, 0xE0, 0x70, 0xE0, 0x70, 0xE0, 0x70, 0xE0, 0x70, 0xE0, 0x70,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 0xC0, 

/* Symbol 0xD4, offset 4136 */
    16, 18, 0,
    0x03, 0x80, 0x03, 0x80, 0x0F, 0xF0, 0x3F, 0xFC, 0x7B, 0x9C, 0xF3, 0x8E,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 0x80, 

/* Symbol 0xD5, offset 4175 */
    14, 18, 0,
    0xE0, 0x1C, 0xF0, 0x38, 0x70, 0x78, 0x38, 0x70, 0x3C, 0xE0, 0x1D, 0xE0,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 0x1C, 

/* Symbol 0xD6, offset 4214 */
    14, 20, 0,
    0xE0, 0x70, 0xE0, 0x70, 0xE0, 0x70, 0xE0, 0x70, 0xE0, 0x70, 0xE0, 0x70,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 0x1C, 

/* Symbol 0xD7, offset 4257 */
    12, 18, 0,
    0xE0, 0x70, 0xE0, 0x70, 0xE0, 0x70, 0xE0, 0x70, 0xE0, 0x70, 0xE0, 0x70,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 0x70, 

/* Symbol 0xD8, offset 4296 */
    16, 18, 0,
    0xE3, 0x87, 0xE3, 0x87, 0xE3, 0x87, 0xE3, 0x87, 0xE3, 0x87, 0xE3, 0x87,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 0xFF, 

/* Symbol 0xD9, offset 4335 */
    16, 20, 0,
    0xE3, 0x87, 0xE3, 0x87, 0xE3, 0x87, 0xE3, 0x87, 0xE3, 0x87, 0xE3, 0x87,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 0x01, 

/* Symbol 0xDA, offset 4378 */
    16, 18, 0,
    0xFC, 0x00, 0x0C, 0x00, 0x0C, 0x00, 0x0C, 0x00, 0x0C, 0x00, 0x0C, 0x00,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 0xFC, 

/* Symbol 0xDB, offset 4417 */
    14, 18, 0,
    0xE0, 0x1C, 0xE0, 0x1C, 0xE0, 0x1C, 0xE0, 0x1C, 0xE0, 0x1C, 0xE0, 0x1C,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 0x1C, 

/* Symbol 0xDC, offset 4456 */
    12, 18, 0,
    0xE0, 0x00, 0xE0, 0x00, 0xE0, 0x00, 0xE0, 0x00, 0xE0, 0x00, 0xE0, 0x00,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 0xC0, 

/* Symbol 0xDD, offset 4495 */
    12, 18, 0,
    0xFF, 0xE0, 0x00, 0xE0, 0x00, 0x70, 0x00, 0x70, 0x00, 0x70, 0x00, 0x70,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 0xC0, 

/* Symbol 0xDE, offset 4534 */
    14, 18, 0,
    0xE7, 0xF8, 0xEF, 0x38, 0xEE, 0x1C, 0xEC, 0x1C, 0xEC, 0x1C, 0xEC, 0x1C,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 0xF0, 

/* Symbol 0xDF, offset 4573 */
    12, 18, 0,
    0x7F, 0xF0, 0xF0, 0x70, 0xE0, 0x70, 0xE0, 0x70, 0xE0, 0x70, 0xE0, 0x70,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 0x70, 

/* Symbol 0xE0, offset 4612 */
    12, 18, 5,
    0x3F, 0xC0, 0x7F, 0xC0, 0xE1, 0xC0, 0xE1, 0xC0, 0xE1, 0xC0, 0xE1, 0xC0, 0xE1, 0xC0, 0xE1, 0xC0, 0xE1, 0xC0, 0xE1, 0xC0, 0xE1, 0xC0, 0x7F, 0xF0, 0x3F, 0x70, 

/* Symbol 0xE1, offset 4641 */
    10, 18, 0,
    0xFF, 0xC0, 0x70, 0x00, 0x38, 0x00, 0x1C, 0x00, 0x0E, 0x00, 0x3F, 0x00,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 0x00, 

/* Symbol 0xE2, offset 4680 */
    10, 18, 0,
    0x7E, 0x00, 0xFE, 0x00, 0xE6, 0x00, 0xEE, 0x00, 0xFE, 0x00, 0xFF, 0x00,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 0x00, 

/* Symbol 0xE3, offset 4719 */
    10, 18, 5,
    0x3F, 0x00, 0xFF, 0x80, 0xE1, 0xC0, 0x01, 0xC0, 0x03, 0xC0, 0x0F, 0x80, 0x1E, 0x00, 0x7C, 0x00, 0xF0, 0x00, 0xE0, 0x00, 0xE0, 0xC0, 0xFF, 0xC0, 0x7F, 0x80, 

/* Symbol 0xE4, offset 4748 */
    10, 18, 0,
    0x7F, 0x80, 0x03, 0xC0, 0x01, 0xC0, 0x01, 0xC0, 0x01, 0xC0, 0x3F, 0xC0,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 0x00, 

/* Symbol 0xE5, offset 4787 */
    10, 18, 5,
    0x3F, 0x00, 0x7F, 0x80, 0xE1, 0xC0, 0xE1, 0xC0, 0xE1, 0xC0, 0xE1, 0xC0, 0xFF, 0xC0, 0xE0, 0x00, 0xE0, 0x00, 0xE0, 0x00, 0xE0, 0x00, 0x7F, 0xC0, 0x3F, 0xC0, 

/* Symbol 0xE6, offset 4816 */
    14, 18, 5,
    0xC7, 0x18, 0xE7, 0x3C, 0xF7, 0x38, 0x77, 0x70, 0x3F, 0xE0, 0x3F, 0xE0, 0x1F, 0xC0, 0x1F, 0xE0, 0x3F, 0xE0, 0x77, 0x70, 0x77, 0x78, 0xE7, 0x38, 0xC7, 0x1C, 

/* Symbol 0xE7, offset 4845 */
    9, 18, 5,
    0x7E, 0x00, 0xFF, 0x00, 0xE3, 0x80, 0x03, 0x80, 0x03, 0x80, 0x07, 0x80, 0x1F, 0x00, 0x07, 0x80, 0x03, 0x80, 0x03, 0x80, 0xC3, 0x80, 0xFF, 0x80, 0x7E, 0x00, 

/* Symbol 0xE8, offset 4874 */
    10, 18, 5,
    0xE1, 0xC0, 0xE1, 0xC0, 0xE1, 0xC0, 0xE1, 0xC0, 0xE1, 0xC0, 0xE1, 0xC0, 0xE1, 0xC0, 0xE1, 0xC0, 0xE1, 0xC0, 0xE1, 0xC0, 0xE1, 0xC0, 0x7F, 0xC0, 0x3F, 0xC0, 

/* Symbol 0xE9, offset 4903 */
    10, 18, 0,
    0x3F, 0x00, 0x00, 0x00, 0x00, 0x00, 0x00, 0x00, 0x00, 0x00, 0xE1, 0xC0,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 0xC0, 

/* Symbol 0xEA, offset 4942 */
    10, 18, 5,
    0xC1, 0xC0, 0xE3, 0xC0, 0xE7, 0x80, 0xEF, 0x00, 0xFE, 0x00, 0xFC, 0x00, 0xFC, 0x00, 0xFE, 0x00, 0xE7, 0x00, 0xE7, 0x00, 0xE3, 0x80, 0xE1, 0xC0, 0xC1, 0xC0, 

/* Symbol 0xEB, offset 4971 */
    10, 18, 5,
    0x0F, 0xC0, 0x1F, 0xC0, 0x1D, 0xC0, 0x1D, 0xC0, 0x39, 0xC0, 0x39, 0xC0, 0x39, 0xC0, 0x71, 0xC0, 0x71, 0xC0, 0x71, 0xC0, 0xE1, 0xC0, 0xE1, 0xC0, 0xE1, 0xC0, 

/* Symbol 0xEC, offset 5000 */
    12, 18, 5,
    0xE0, 0x70, 0xE0, 0xF0, 0xF0, 0xF0, 0xF9, 0xF0, 0xFB, 0xF0, 0xFF, 0xF0, 0xEF, 0x70, 0xEE, 0x70, 0xE0, 0x70, 0xE0, 0x70, 0xE0, 0x70, 0xE0, 0x70, 0xE0, 0x70, 

/* Symbol 0xED, offset 5029 */
    10, 18, 5,
    0xE1, 0xC0, 0xE1, 0xC0, 0xE1, 0xC0, 0xE1, 0xC0, 0xE1, 0xC0, 0xE1, 0xC0, 0xFF, 0xC0, 0xE1, 0xC0, 0xE1, 0xC0, 0xE1, 0xC0, 0xE1, 0xC0, 0xE1, 0xC0, 0xE1, 0xC0, 

/* Symbol 0xEE, offset 5058 */
    10, 18, 5,
    0x3F, 0x00, 0x7F, 0x80, 0xE1, 0xC0, 0xE1, 0xC0, 0xE1, 0xC0, 0xE1, 0xC0, 0xE1, 0xC0, 0xE1, 0xC0, 0xE1, 0xC0, 0xE1, 0xC0, 0xE1, 0xC0, 0x7F, 0x80, 0x3F, 0x00, 

/* Symbol 0xEF, offset 5087 */
    10, 18, 5,
    0xFF, 0x00, 0xFF, 0x80, 0xE1, 0xC0, 0xE1, 0xC0, 0xE1, 0xC0, 0xE1, 0xC0, 0xE1, 0xC0, 0xE1, 0xC0, 0xE1, 0xC0, 0xE1, 0xC0, 0xE1, 0xC0, 0xE1, 0xC0, 0xE1, 0xC0, 

/* Symbol 0xF0, offset 5116 */
    10, 20, 5,
    0xFF, 0x00, 0xFF, 0x80, 0xE1, 0xC0, 0xE1, 0xC0, 0xE1, 0xC0, 0xE1, 0xC0, 0xE1, 0xC0, 0xE1, 0xC0, 0xE1, 0xC0, 0xE1, 0xC0, 0xE1, 0xC0, 0xFF, 0x80, 0xFF, 0x00, 0xE0, 0x00, 0xE0, 0x00, 

/* Symbol 0xF1, offset 5149 */
    8, 18, 5,
    0x3F, 0x7F, 0xE0, 0xE0, 0xE0, 0xE0, 0xE0, 0xE0, 0xE0, 0xE0, 0xE0, 0x7F, 0x3F, 

/* Symbol 0xF2, offset 5165 */
    14, 18, 5,
    0xFF, 0xF0, 0xFF, 0xF8, 0xE7, 0x3C, 0xE7, 0x1C, 0xE7, 0x1C, 0xE7, 0x1C, 0xE7, 0x1C, 0xE7, 0x1C, 0xE7, 0x1C, 0xE7, 0x1C, 0xE7, 0x1C, 0xE7, 0x1C, 0xE7, 0x1C, 

/* Symbol 0xF3, offset 5194 */
    10, 20, 5,
    0xE1, 0xC0, 0xE1, 0xC0, 0xE1, 0xC0, 0xE1, 0xC0, 0xE1, 0xC0, 0xE1, 0xC0, 0xE1, 0xC0, 0xE1, 0xC0, 0xE1, 0xC0, 0xE1, 0xC0, 0xE1, 0xC0, 0x7F, 0xC0, 0x3F, 0xC0, 0x01, 0xC0, 0x01, 0xC0, 

/* Symbol 0xF4, offset 5227 */
    14, 20, 1,
    0x03, 0x00, 0x07, 0x00, 0x07, 0x00, 0x07, 0x00, 0x1F, 0xC0, 0x3F, 0xF0,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 0x00, 

/* Symbol 0xF5, offset 5268 */
    10, 18, 5,
    0xE1, 0xC0, 0xE1, 0xC0, 0x73, 0x80, 0x7F, 0x80, 0x3F, 0x00, 0x1E, 0x00, 0x1E, 0x00, 0x1E, 0x00, 0x3F, 0x00, 0x7F, 0x80, 0x73, 0x80, 0xE1, 0xC0, 0xE1, 0xC0, 

/* Symbol 0xF6, offset 5297 */
    12, 20, 5,
    0xE1, 0xC0, 0xE1, 0xC0, 0xE1, 0xC0, 0xE1, 0xC0, 0xE1, 0xC0, 0xE1, 0xC0, 0xE1, 0xC0, 0xE1, 0xC0, 0xE1, 0xC0, 0xE1, 0xC0, 0xE1, 0xC0, 0x7F, 0xF0, 0x3F, 0xF0, 0x00, 0x70, 0x00, 0x70, 

/* Symbol 0xF7, offset 5330 */
    10, 18, 5,
    0xE1, 0xC0, 0xE1, 0xC0, 0xE1, 0xC0, 0xE1, 0xC0, 0xE1, 0xC0, 0xF1, 0xC0, 0x7F, 0xC0, 0x01, 0xC0, 0x01, 0xC0, 0x01, 0xC0, 0x01, 0xC0, 0x01, 0xC0, 0x01, 0xC0, 

/* Symbol 0xF8, offset 5359 */
    14, 18, 5,
    0xE3, 0x1C, 0xE7, 0x1C, 0xE7, 0x1C, 0xE7, 0x1C, 0xE7, 0x1C, 0xE7, 0x1C, 0xE7, 0x1C, 0xE7, 0x1C, 0xE7, 0x1C, 0xE7, 0x1C, 0xE7, 0x1C, 0x7F, 0xFC, 0x3F, 0xFC, 

/* Symbol 0xF9, offset 5388 */
    16, 20, 5,
    0xE3, 0x1C, 0xE7, 0x1C, 0xE7, 0x1C, 0xE7, 0x1C, 0xE7, 0x1C, 0xE7, 0x1C, 0xE7, 0x1C, 0xE7, 0x1C, 0xE7, 0x1C, 0xE7, 0x1C, 0xE7, 0x1C, 0x7F, 0xFE, 0x3F, 0xFF, 0x00, 0x07, 0x00, 0x06, 

/* Symbol 0xFA, offset 5421 */
    11, 18, 5,
    0xF0, 0x00, 0xF0, 0x00, 0x70, 0x00, 0x70, 0x00, 0x70, 0x00, 0x70, 0x00, 0x7F, 0xC0, 0x71, 0xE0, 0x70, 0xE0, 0x70, 0xE0, 0x70, 0xE0, 0x7F, 0xC0, 0x7F, 0x80, 

/* Symbol 0xFB, offset 5450 */
    12, 18, 5,
    0xE0, 0x70, 0xE0, 0x70, 0xE0, 0x70, 0xE0, 0x70, 0xE0, 0x70, 0xE0, 0x70, 0xFE, 0x70, 0xEF, 0x70, 0xE7, 0x70, 0xE7, 0x70, 0xE7, 0x70, 0xFF, 0x70, 0xFE, 0x70, 

/* Symbol 0xFC, offset 5479 */
    10, 18, 5,
    0xE0, 0x00, 0xE0, 0x00, 0xE0, 0x00, 0xE0, 0x00, 0xE0, 0x00, 0xE0, 0x00, 0xFF, 0x80, 0xE3, 0xC0, 0xE1, 0xC0, 0xE1, 0xC0, 0xE1, 0xC0, 0xFF, 0x80, 0xFF, 0x00, 

/* Symbol 0xFD, offset 5508 */
    10, 18, 5,
    0xFF, 0x00, 0xFF, 0x80, 0x01, 0xC0, 0x01, 0xC0, 0x01, 0xC0, 0x01, 0xC0, 0x0F, 0xC0, 0x01, 0xC0, 0x01, 0xC0, 0x01, 0xC0, 0x01, 0xC0, 0xFF, 0x80, 0xFF, 0x00, 

/* Symbol 0xFE, offset 5537 */
    12, 18, 5,
    0xE7, 0xC0, 0xEF, 0xE0, 0xEE, 0x70, 0xEC, 0x70, 0xEC, 0x70, 0xEC, 0x70, 0xFC, 0x70, 0xEC, 0x70, 0xEC, 0x70, 0xEC, 0x70, 0xEE, 0x70, 0xEF, 0xE0, 0xE7, 0xC0, 

/* Symbol 0xFF, offset 5566 */
    10, 18, 5,
    0x3F, 0xC0, 0x7F, 0xC0, 0xE1, 0xC0, 0xE1, 0xC0, 0xE1, 0xC0, 0xF1, 0xC0, 0x7F, 0xC0, 0x1D, 0xC0, 0x39, 0xC0, 0x79, 0xC0, 0x71, 0xC0, 0xE1, 0xC0, 0xE1, 0xC0
};
